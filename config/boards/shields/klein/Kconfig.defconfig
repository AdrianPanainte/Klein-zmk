## config/boards/shields/klein/Kconfig.defconfig
```kconfig
if SHIELD_KLEIN_RIGHT

config ZMK_KEYBOARD_NAME
    default "klein"

config ZMK_SPLIT_BLE_ROLE_CENTRAL
	default y
    
endif

if SHIELD_KLEIN_LEFT || SHIELD_KLEIN_RIGHT

config ZMK_SPLIT
    default y

config ZMK_SLEEP
    default y

config ZMK_POINTING
    default y

config SPI
    default y

config I2C
    default y

config INPUT
    default y

config ZMK_MOUSE
    default y

config INPUT_AZOTEQ_IQS5XX
    default y
    
endif
```

## config/west.yml
```yaml
manifest:
  remotes:
    - name: zmkfirmware
      url-base: https://github.com/zmkfirmware
    - name: infused-kim
      url-base: https://github.com/infused-kim
    - name: aym1607
      url-base: https://github.com/AYM1607
    - name: nuovotaka
      url-base: https://github.com/nuovotaka
  projects:
    - name: zmk
      remote: zmkfirmware
      revision: v0.3
      import: app/west.yml
    - name: zmk-driver-azoteq-iqs5xx
      remote: aym1607
      revision: main
    - name: zmk-pointing-acceleration-alpha
      remote: nuovotaka
      revision: main
  self:
    path: config
```
